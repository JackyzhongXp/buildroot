## package/leaktracer/Config.in
```kconfig
config BR2_PACKAGE_LEAKTRACER
	bool "leaktracer"
	help
	  LeakTracer is a small tool written to check a C++ program for memory
	  leaks. Ideal if valgrind is not ported to your platform or if you
	  can't use libduma.

	  https://github.com/fredericgermain/LeakTracer
```

## package/qt_eventdispatcher_libevent/Config.in
```kconfig
config BR2_PACKAGE_QT_EVENTDISPATCHER_LIBEVENT
	bool "qt_eventdispatcher_libevent"
	select BR2_PACKAGE_LIBEVENT
	help
	  libevent-based event dispatcher for Qt

	  https://github.com/sjinks/qt_eventdispatcher_libevent
```
